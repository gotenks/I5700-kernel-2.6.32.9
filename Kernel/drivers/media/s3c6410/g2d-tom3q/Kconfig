## Kernel/drivers/media/s3c6410/g2d-tom3q/Kconfig
```kconfig
#
## G2D subsystem configuration
##
#
##menu "G2D Support"

config TOM3Q_VIDEO_G2D
	bool "TOM3Q FIMG-2D Driver"
	depends on CPU_S3C6410
	default n
	help
	    FIMG-2D
#endmenu
```

## Kernel/drivers/media/s3c6410/g3d-tom3q/Kconfig
```kconfig
#
## G2D subsystem configuration
##
#
##menu "G2D Support"

config TOM3Q_VIDEO_G3D
	bool	"TOM3Q FIMG-3D Driver"
	depends on CPU_S3C6410
	default n
	help
	    FIMG-3D
#endmenu
```
